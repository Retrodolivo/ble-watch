## CMakeLists.txt
```
# SPDX-License-Identifier: Apache-2.0

cmake_minimum_required(VERSION 3.20.0)

# E-ink panel on the Waveshare e-Paper HAT, wired to the DK's Arduino header.
# The shield overlay adds the SSD1681 node; pinout is in docs/hardware.md.
set(SHIELD waveshare_epaper_gdeh0154a07)

find_package(Zephyr REQUIRED HINTS $ENV{ZEPHYR_BASE})
project(ble_watch)

target_sources(app PRIVATE src/main.c src/clock.c)
```

## sysbuild.conf
```
# Sysbuild builds several images together. This adds MCUboot as a second image
# that runs first at reset, checks the app's signature, and then starts it.
SB_CONFIG_BOOTLOADER_MCUBOOT=y

# Signature type (also the NCS default on the nRF52840). For now the image is
# signed with MCUboot's public demo key (root-ec-p256.pem): our own key comes later.
SB_CONFIG_BOOT_SIGNATURE_TYPE_ECDSA_P256=y
```

## prj.conf
```kconfig
# LED control through the GPIO driver
CONFIG_GPIO=y

# Logging, printed on the UART console (DK's USB serial, 115200 baud)
CONFIG_LOG=y
CONFIG_LOG_DEFAULT_LEVEL=3

# Display subsystem; the SSD16xx driver is enabled by the shield's devicetree node
CONFIG_DISPLAY=y

# Bluetooth LE peripheral (NCS uses Nordic's SoftDevice Controller as the link layer)
CONFIG_BT=y
CONFIG_BT_PERIPHERAL=y
CONFIG_BT_DEVICE_NAME="ble-watch"

# Zephyr's Current Time Service (0x1805); our callbacks are in src/ble.c
CONFIG_BT_CTS=y

# Firmware updates over BLE: MCUmgr with the SMP service, the BT transport and the
# image group (writes the new image to slot 1). NCS helper option from
# nrf/samples/common/mcumgr_bt_ota_dfu. Used with the nRF Connect Device Manager app.
CONFIG_NCS_SAMPLE_MCUMGR_BT_OTA_DFU=y

# Version written in the image header by the signing step; shown in Device Manager.
CONFIG_MCUBOOT_IMGTOOL_SIGN_VERSION="0.2.0+0"
```

## debug.conf
```kconfig
# Extra Kconfig for debugging with GDB. Use it on top of prj.conf:
#   west build -b nrf52840dk/nrf52840 app -p -- -DEXTRA_CONF_FILE=debug.conf

# -Og instead of -Os: code follows the source, variables stay visible
CONFIG_DEBUG_OPTIMIZATIONS=y

# Let the debugger see Zephyr threads, with their names
CONFIG_DEBUG_THREAD_INFO=y
CONFIG_THREAD_NAME=y

# Stop on a failed __ASSERT() instead of running with bad state
CONFIG_ASSERT=y
```

## boards/nrf52840dk_nrf52840.overlay
```dts
/*
 * App overlay for the nRF52840 DK, applied after the board and shield devicetree.
 */

#include <zephyr/dt-bindings/gpio/arduino-header-r3.h>

/*
 * BUSY (D7, P1.08): add a pull-down. Without the panel the pin floats and can
 * read "busy" forever, which blocks the SSD16xx driver init before main().
 * With the panel connected, the controller drives BUSY, so the weak pull-down
 * (about 13 kOhm) changes nothing.
 */
&ssd16xx_waveshare_epaper_gdeh0154a07 {
	busy-gpios = <&arduino_header ARDUINO_HEADER_R3_D7 (GPIO_ACTIVE_HIGH | GPIO_PULL_DOWN)>;
};
```

## src/main.c
```c
/*
 * ble-watch: test pattern on the e-ink display, LED blink, and a clock
 * that logs HH:MM at each new minute and is set over BLE (Current Time Service).
 */

#include <stdio.h>
#include <string.h>

#include <zephyr/kernel.h>
#include <zephyr/device.h>
#include <zephyr/drivers/display.h>
#include <zephyr/drivers/gpio.h>
#include <zephyr/logging/log.h>

#include "ble.h"
#include "clock.h"

LOG_MODULE_REGISTER(main, LOG_LEVEL_INF);

#define BLINK_PERIOD_MS 500

/* Panel size from the shield overlay (width/height properties). */
#define DISPLAY_NODE DT_CHOSEN(zephyr_display)
#define WIDTH        DT_PROP(DISPLAY_NODE, width)
#define HEIGHT       DT_PROP(DISPLAY_NODE, height)
#define SQUARE       25 /* checkerboard square size in pixels */

/* "led0" is an alias in the board devicetree (LED1 on the DK). */
static const struct gpio_dt_spec led = GPIO_DT_SPEC_GET(DT_ALIAS(led0), gpios);

/* "zephyr,display" is chosen by the shield overlay. */
static const struct device *const display = DEVICE_DT_GET(DISPLAY_NODE);

/* 1 bit per pixel: 200 * 200 / 8 = 5000 bytes. */
static uint8_t framebuf[WIDTH * HEIGHT / 8];

/*
 * Set one pixel to black. MONO10 means bit 1 = black.
 * The SSD16xx driver uses "vertical tiling" in normal orientation:
 * each byte holds 8 pixels stacked vertically, MSB on top.
 */
static void set_black(int x, int y, bool vtiled)
{
	size_t idx;
	uint8_t bit;

	if (vtiled) {
		idx = (y / 8) * WIDTH + x;
		bit = 7 - (y % 8);
	} else {
		idx = (y * WIDTH + x) / 8;
		bit = 7 - (x % 8);
	}
	framebuf[idx] |= BIT(bit);
}

static int draw_test_pattern(void)
{
	struct display_capabilities caps;
	struct display_buffer_descriptor desc = {
		.buf_size = sizeof(framebuf),
		.width = WIDTH,
		.height = HEIGHT,
		.pitch = WIDTH,
	};
	bool vtiled;
	int ret;

	if (!device_is_ready(display)) {
		LOG_ERR("Display %s not ready", display->name);
		return -ENODEV;
	}

	display_get_capabilities(display, &caps);
	vtiled = (caps.screen_info & SCREEN_INFO_MONO_VTILED) != 0;
	LOG_INF("Display %s: %ux%u, pixel format 0x%x, vtiled %d", display->name,
		caps.x_resolution, caps.y_resolution, caps.current_pixel_format, vtiled);

	/* Checkerboard, plus a solid 3-pixel black border. */
	memset(framebuf, 0, sizeof(framebuf));
	for (int y = 0; y < HEIGHT; y++) {
		for (int x = 0; x < WIDTH; x++) {
			bool square = ((x / SQUARE) + (y / SQUARE)) % 2 == 0;
			bool border = x < 3 || y < 3 || x >= WIDTH - 3 || y >= HEIGHT - 3;

			if (square || border) {
				set_black(x, y, vtiled);
			}
		}
	}

	ret = display_write(display, 0, 0, &desc, framebuf);
	if (ret < 0) {
		LOG_ERR("display_write failed: %d", ret);
		return ret;
	}

	/* Blanking off triggers the full refresh (takes a few seconds on e-ink). */
	ret = display_blanking_off(display);
	if (ret < 0) {
		LOG_ERR("display_blanking_off failed: %d", ret);
		return ret;
	}

	LOG_INF("Test pattern drawn");
	return 0;
}

/* Runs in interrupt context every BLINK_PERIOD_MS: keep it short. */
static void blink_handler(struct k_timer *timer)
{
	ARG_UNUSED(timer);
	gpio_pin_toggle_dt(&led);
}

K_TIMER_DEFINE(blink_timer, blink_handler, NULL);

/* Start time = build time ("HH:MM:SS" from the compiler), until BLE can set it. */
static void clock_set_from_build_time(void)
{
	unsigned int h, m, s;

	if (sscanf(__TIME__, "%u:%u:%u", &h, &m, &s) == 3) {
		clock_set(h, m, s);
	} else {
		clock_set(0, 0, 0);
	}
}

int main(void)
{
	int ret;

	LOG_INF("ble-watch starting on %s", CONFIG_BOARD_TARGET);

	if (!gpio_is_ready_dt(&led)) {
		LOG_ERR("LED GPIO device not ready");
		return 0;
	}

	ret = gpio_pin_configure_dt(&led, GPIO_OUTPUT_INACTIVE);
	if (ret < 0) {
		LOG_ERR("Failed to configure LED: %d", ret);
		return 0;
	}

	/* Blink keeps going even if the display fails, so we know the app runs. */
	k_timer_start(&blink_timer, K_MSEC(BLINK_PERIOD_MS), K_MSEC(BLINK_PERIOD_MS));

	(void)draw_test_pattern();

	clock_set_from_build_time();

	/* If BLE fails, the clock still runs from the build time. */
	(void)ble_init();

	while (1) {
		/*
		 * Sleep until hh:mm:00, or until the time is set (at boot or
		 * from the phone). The thread uses no CPU while it waits.
		 */
		(void)clock_wait_next_minute();

		uint32_t now = clock_now();

		LOG_INF("Time %02u:%02u (uptime %lld s)", now / 3600, (now / 60) % 60,
			k_uptime_get() / MSEC_PER_SEC);
	}

	return 0;
}
```

## src/ble.c
```c
/*
 * BLE peripheral: advertises as CONFIG_BT_DEVICE_NAME and exposes the
 * Current Time Service (CTS, UUID 0x1805) from Zephyr (CONFIG_BT_CTS).
 * Writing the Current Time characteristic (0x2A2B) sets our clock.
 */

#include <zephyr/kernel.h>
#include <zephyr/bluetooth/bluetooth.h>
#include <zephyr/bluetooth/conn.h>
#include <zephyr/bluetooth/uuid.h>
#include <zephyr/bluetooth/services/cts.h>
#include <zephyr/logging/log.h>

#include "ble.h"
#include "clock.h"

LOG_MODULE_REGISTER(ble, LOG_LEVEL_INF);

/* Advertising packet: flags + "I have a Current Time Service". */
static const struct bt_data ad[] = {
	BT_DATA_BYTES(BT_DATA_FLAGS, (BT_LE_AD_GENERAL | BT_LE_AD_NO_BREDR)),
	BT_DATA_BYTES(BT_DATA_UUID16_ALL, BT_UUID_16_ENCODE(BT_UUID_CTS_VAL)),
};

/* Scan response: the device name, sent when the phone asks for more. */
static const struct bt_data sd[] = {
	BT_DATA(BT_DATA_NAME_COMPLETE, CONFIG_BT_DEVICE_NAME, sizeof(CONFIG_BT_DEVICE_NAME) - 1),
};

/* Local Time Information (time zone, DST): stored, but not used for HH:MM. */
static struct bt_cts_local_time local_time = {
	.timezone_offset = BT_CTS_TIMEZONE_DEFAULT_VALUE,
	.dst_offset = BT_CTS_DST_OFFSET_UNKNOWN,
};

static void adv_start(void)
{
	int err = bt_le_adv_start(BT_LE_ADV_CONN_FAST_1, ad, ARRAY_SIZE(ad), sd, ARRAY_SIZE(sd));

	if (err) {
		LOG_ERR("Advertising failed to start: %d", err);
		return;
	}
	LOG_INF("Advertising as \"%s\"", CONFIG_BT_DEVICE_NAME);
}

/* Restart advertising from a work item, not from inside the BT callback. */
static void adv_work_handler(struct k_work *work)
{
	ARG_UNUSED(work);
	adv_start();
}

static K_WORK_DEFINE(adv_work, adv_work_handler);

static void connected(struct bt_conn *conn, uint8_t err)
{
	char addr[BT_ADDR_LE_STR_LEN];

	bt_addr_le_to_str(bt_conn_get_dst(conn), addr, sizeof(addr));
	if (err) {
		LOG_WRN("Connection to %s failed: 0x%02x", addr, err);
		return;
	}
	LOG_INF("Connected: %s", addr);
}

static void disconnected(struct bt_conn *conn, uint8_t reason)
{
	LOG_INF("Disconnected, reason 0x%02x", reason);
}

/* The connection object is free again: now we can advertise for a new one. */
static void recycled(void)
{
	k_work_submit(&adv_work);
}

BT_CONN_CB_DEFINE(conn_callbacks) = {
	.connected = connected,
	.disconnected = disconnected,
	.recycled = recycled,
};

/* Phone wrote Current Time: 10 bytes, we only use hours, minutes and seconds. */
static int cts_time_write(struct bt_cts_time_format *t)
{
	if (t->hours > 23 || t->min > 59 || t->sec > 59) {
		LOG_WRN("Rejected time %u:%u:%u", t->hours, t->min, t->sec);
		return -EINVAL;
	}

	clock_set(t->hours, t->min, t->sec);
	return 0;
}

/* Phone reads Current Time. We don't track the date: 0 means "unknown" in CTS. */
static int cts_fill_time(struct bt_cts_time_format *t)
{
	uint32_t now = clock_now();

	*t = (struct bt_cts_time_format){
		.hours = now / 3600,
		.min = (now / 60) % 60,
		.sec = now % 60,
	};
	return 0;
}

static int cts_local_time_write(const struct bt_cts_local_time *lt)
{
	local_time = *lt;
	return 0;
}

static int cts_fill_local_time(struct bt_cts_local_time *lt)
{
	*lt = local_time;
	return 0;
}

static const struct bt_cts_cb cts_cb = {
	.cts_time_write = cts_time_write,
	.fill_current_cts_time = cts_fill_time,
	.cts_local_time_write = cts_local_time_write,
	.fill_current_cts_local_time = cts_fill_local_time,
};

int ble_init(void)
{
	int err;

	err = bt_cts_init(&cts_cb);
	if (err) {
		LOG_ERR("CTS init failed: %d", err);
		return err;
	}

	err = bt_enable(NULL);
	if (err) {
		LOG_ERR("Bluetooth init failed: %d", err);
		return err;
	}

	adv_start();
	return 0;
}
```

## src/ble.h
```c
/*
 * BLE peripheral with the Current Time Service.
 */

#ifndef BLE_WATCH_BLE_H_
#define BLE_WATCH_BLE_H_

/* Enable Bluetooth, register CTS and start advertising. */
int ble_init(void);

#endif /* BLE_WATCH_BLE_H_ */
```

## src/clock.c
```c
/*
 * Time of day = (time set by the user) + (uptime since it was set).
 *
 * Uptime comes from the Zephyr system timer. On the nRF52840 that is RTC1,
 * clocked by the 32.768 kHz crystal on the DK (CONFIG_CLOCK_CONTROL_NRF_K32SRC_XTAL).
 * The RTC keeps running in sleep, so no extra hardware timer is needed.
 */

#include <zephyr/kernel.h>
#include <zephyr/logging/log.h>

#include "clock.h"

LOG_MODULE_REGISTER(clock, LOG_LEVEL_INF);

/* Time of day (in ms since midnight) at the moment clock_set() was called. */
static int64_t base_ms;
/* k_uptime_get() at the moment clock_set() was called. */
static int64_t base_uptime_ms;

static int64_t now_ms(void)
{
	int64_t elapsed = k_uptime_get() - base_uptime_ms;

	return (base_ms + elapsed) % ((int64_t)CLOCK_SECONDS_PER_DAY * MSEC_PER_SEC);
}

void clock_set(uint8_t hours, uint8_t minutes, uint8_t seconds)
{
	base_uptime_ms = k_uptime_get();
	base_ms = ((hours % 24) * 3600 + (minutes % 60) * 60 + (seconds % 60)) *
		  (int64_t)MSEC_PER_SEC;

	LOG_INF("Time set to %02u:%02u:%02u", hours % 24, minutes % 60, seconds % 60);
}

uint32_t clock_now(void)
{
	return (uint32_t)(now_ms() / MSEC_PER_SEC);
}

uint32_t clock_ms_to_next_minute(void)
{
	return 60 * MSEC_PER_SEC - (uint32_t)(now_ms() % (60 * MSEC_PER_SEC));
}
```

## src/clock.h
```c
/*
 * Wall-clock time of day, counted from the Zephyr system timer.
 */

#ifndef BLE_WATCH_CLOCK_H_
#define BLE_WATCH_CLOCK_H_

#include <stdbool.h>
#include <stdint.h>

#define CLOCK_SECONDS_PER_DAY (24 * 60 * 60)

/* Set the current time of day. */
void clock_set(uint8_t hours, uint8_t minutes, uint8_t seconds);

/* Seconds since midnight, 0 .. CLOCK_SECONDS_PER_DAY - 1. */
uint32_t clock_now(void);

/* Milliseconds until the next full minute (00 seconds). */
uint32_t clock_ms_to_next_minute(void);

/*
 * Block until the next full minute, or until clock_set() is called.
 * Returns true if it woke up because the time was set.
 */
bool clock_wait_next_minute(void);

#endif /* BLE_WATCH_CLOCK_H_ */
```
